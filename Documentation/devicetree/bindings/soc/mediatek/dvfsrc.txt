## Documentation/devicetree/bindings/soc/mediatek/dvfsrc.txt
```
MediaTek DVFSRC

The Dynamic Voltage and Frequency Scaling Resource Collector (DVFSRC) is a
HW module which is used to collect all the requests from both software and
hardware and turn into the decision of minimum operating voltage and minimum
DRAM frequency to fulfill those requests.

Required Properties:
- compatible: Should be one of the following
	- "mediatek,mt8183-dvfsrc": For MT8183 SoC
	- "mediatek,mt6779-dvfsrc": For MT6779 SoC
	- "mediatek,mt6765-dvfsrc": For MT6765 SoC
- reg: Address range of the DVFSRC unit
- clock-names: Must include the following entries:
	"dvfsrc": DVFSRC module clock
- clocks: Must contain an entry for each entry in clock-names.
- #interconnect-cells : should contain 1
- interconnect : interconnect providers support dram bandwidth requirements.
	The provider is able to communicate with the DVFSRC and send the dram
	bandwidth to it. shall contain only one of the following:
	"mediatek,dvfsrc-mt8183-emi"
	"mediatek,dvfsrc-mt6779-emi"

Optional Properties:
- mediatek,legacy-vcorefs: Select the older SPM VCOREFS secure-call protocol
  on MT6765 with normal-flavor voltage calibration. DRAM type/frequency and
  efuses supply the firmware selection and voltage table. Alternate voltage
  modes are not supported by this protocol.

Example:

	dvfsrc@10012000 {
		compatible = "mediatek,mt8183-dvfsrc";
		reg = <0 0x10012000 0 0x1000>;
		clocks = <&infracfg CLK_INFRA_DVFSRC>;
		clock-names = "dvfsrc";
		ddr_emi: interconnect {
			compatible = "mediatek,mt8183-emi";
			#interconnect-cells = <1>;
		};
	};
```

## drivers/input/touchscreen/mediatek/focaltech_mmi/Kconfig
```kconfig
# FocalTech FT8201 touchscreen driver

config TOUCHSCREEN_MTK_FT8201
	bool "FocalTech FT8201 touchscreen"
	help
	  Say Y here for the FocalTech FT8201 controller on the Lenovo
	  TB-X606F. This driver supports touch reporting, gestures and
	  controller firmware loading through the MediaTek touch framework.

	  If unsure, say N.
```

## drivers/misc/mediatek/sensors-1.0/capsensor/Kconfig
```kconfig
#
# Input misc drivers configuration
#
config MTK_SX9310
	tristate "SX9310_SAR_sensor"
	depends on I2C
	default y
	help
	  Say Y to enable the SAR detection application, if N here not to use the
	  this SAR sensor

config MTK_SX9311
	tristate "Lenovo SX9311 SAR sensor"
	depends on I2C && INPUT
	select REGMAP_I2C
	help
	  SX9311 SAR input support with the TB-X606F Android 10 tuning and
	  key mapping. This is separate from the donor SX932x implementation.
```
